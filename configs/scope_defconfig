## configs/scope_defconfig
```kconfig
BR2_arm=y
BR2_cortex_a7=y
BR2_ARM_FPU_VFPV4=y
BR2_TOOLCHAIN_EXTERNAL=y
BR2_INIT_SYSTEMD=y
BR2_TARGET_GENERIC_ROOT_PASSWD="qaz"
BR2_ROOTFS_OVERLAY="board/scope/rootfs_overlay"
BR2_ROOTFS_POST_IMAGE_SCRIPT="support/scripts/genimage.sh board/scope/post-image.sh"
BR2_ROOTFS_POST_SCRIPT_ARGS="-c board/scope/genimage.cfg"
BR2_LINUX_KERNEL=y
BR2_LINUX_KERNEL_CUSTOM_GIT=y
BR2_LINUX_KERNEL_CUSTOM_REPO_URL="https://github.com/zaporozhets/linux.git"
BR2_LINUX_KERNEL_CUSTOM_REPO_VERSION="scope-master"
BR2_LINUX_KERNEL_DEFCONFIG="scope"
BR2_LINUX_KERNEL_DTS_SUPPORT=y
BR2_LINUX_KERNEL_INTREE_DTS_NAME="scope"
BR2_LINUX_KERNEL_INSTALL_TARGET=y
BR2_PACKAGE_GDB=y
BR2_PACKAGE_DEJAVU=y
BR2_PACKAGE_DOOM_WAD=y
BR2_PACKAGE_PRBOOM=y
BR2_PACKAGE_QT5=y
BR2_PACKAGE_QT5BASE_DEFAULT_QPA="linuxfb"
BR2_PACKAGE_QT5BASE_FONTCONFIG=y
BR2_PACKAGE_QT5BASE_GIF=y
BR2_PACKAGE_QT5BASE_JPEG=y
BR2_PACKAGE_QT5BASE_PNG=y
BR2_PACKAGE_QT5BASE_DBUS=y
BR2_PACKAGE_QT5BASE_TSLIB=y
BR2_PACKAGE_QT5CHARTS=y
BR2_PACKAGE_QT5MULTIMEDIA=y
BR2_PACKAGE_QT5QUICKCONTROLS=y
BR2_PACKAGE_QT5QUICKCONTROLS2=y
BR2_PACKAGE_QWT=y
BR2_PACKAGE_I2C_TOOLS=y
BR2_PACKAGE_UBOOT_TOOLS=y
BR2_PACKAGE_C_PERIPHERY=y
BR2_PACKAGE_LIBUSB=y
BR2_PACKAGE_OPENSSH=y
BR2_PACKAGE_BASH=y
BR2_PACKAGE_SWUPDATE=y
BR2_PACKAGE_SWUPDATE_CONFIG="board/scope/swupdate.config"
# BR2_PACKAGE_SWUPDATE_INSTALL_WEBSITE is not set
BR2_TARGET_ROOTFS_EXT2=y
BR2_TARGET_ROOTFS_EXT2_4=y
BR2_TARGET_ROOTFS_EXT2_SIZE="512M"
BR2_TARGET_UBOOT=y
BR2_TARGET_UBOOT_BUILD_SYSTEM_KCONFIG=y
BR2_TARGET_UBOOT_CUSTOM_GIT=y
BR2_TARGET_UBOOT_CUSTOM_REPO_URL="https://github.com/zaporozhets/u-boot"
BR2_TARGET_UBOOT_CUSTOM_REPO_VERSION="scope"
BR2_TARGET_UBOOT_BOARD_DEFCONFIG="scope"
BR2_TARGET_UBOOT_NEEDS_DTC=y
BR2_TARGET_UBOOT_NEEDS_PYLIBFDT=y
BR2_TARGET_UBOOT_FORMAT_CUSTOM=y
BR2_TARGET_UBOOT_FORMAT_CUSTOM_NAME="u-boot-sunxi-with-spl.bin"
BR2_TARGET_UBOOT_ENVIMAGE=y
BR2_TARGET_UBOOT_ENVIMAGE_SOURCE="board/scope/uboot-env.txt"
BR2_TARGET_UBOOT_ENVIMAGE_SIZE="0x20000"
BR2_PACKAGE_HOST_DOSFSTOOLS=y
BR2_PACKAGE_HOST_GENIMAGE=y
BR2_PACKAGE_HOST_MTOOLS=y
BR2_PACKAGE_HOST_UBOOT_TOOLS=y
```

## package/hackrf/Config.in
```kconfig
config BR2_PACKAGE_HACKRF
	bool "hackrf"
	depends on BR2_TOOLCHAIN_HAS_THREADS
	help
	  Library and tools for accessing HackRF SDR boards.

	  https://github.com/mossmann/hackrf/tree/master/host

comment "hackrf needs a toolchain w/ threads"
	depends on !BR2_TOOLCHAIN_HAS_THREADS
    depends on BR2_PACKAGE_FFTW_PRECISION_SINGLE
```
